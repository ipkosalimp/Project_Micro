#include<SPI.h>
#include<nRF24L01.h>
#include<RF24.h>
#include <Wire.h>

#include <Adafruit_GFX.h>
#include <Adafruit_SSD1306.h>

#define SCREEN_WIDTH 128 // OLED display width, in pixels
#define SCREEN_HEIGHT 64 // OLED display height, in pixels

#define pinbat A7
#define pinLeft   5
#define pinRight  6
#define pinUp     2
#define pinDown   3
#define pinMod    7
#define pinKick   8
#define pinSpare  4

byte mod,up,dwn,lft,rgt,kick;
byte mod_btn,up_btn,dwn_btn,lft_btn,rgt_btn,kick_btn;
byte mod_F;
byte select=0;
byte mainch,subch;
int batval;
int tmr;

int pesan[2]={0,1};
const int tombol=2;
const int tombol2=3;
RF24 rf24(9,10);  //def 7,8

//byte alamat ="INO1099";
//byte ino="ino";
//int robo=123;
//byte alamat=ino+robo;
unsigned long alamat=1000;

#define OLED_RESET     4 // Reset pin # (or -1 if sharing Arduino reset pin)
Adafruit_SSD1306 display(SCREEN_WIDTH, SCREEN_HEIGHT, &Wire, OLED_RESET);

#define NUMFLAKES     10 // Number of snowflakes in the animation example

#define LOGO_HEIGHT   128
#define LOGO_WIDTH    64
static const unsigned char PROGMEM logo_bmp[] =
{ 
  0x00, 0x00, 0x00, 0x00, 0x00, 0x00, 0x00, 0x00, 
  0x00, 0x00, 0x10, 0x0b, 0xd0, 0x08, 0x00, 0x00, 
  0x00, 0x00, 0x10, 0x3f, 0xfc, 0x10, 0x00, 0x00, 
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  0x00, 0x0b, 0xff, 0xf4, 0x2a, 0xaa, 0xa8, 0x00,  };


void setup() {
   display.setTextSize(1); // Draw 2X-scale text(1=7px, 2=14px it means 2 times from the pixel)
  display.setTextColor(WHITE);
  display.cp437(true);         // Use full 256 char 'Code Page 437' font
  display.clearDisplay();
  // SSD1306_SWITCHCAPVCC = generate display voltage from 3.3V internally
  if(!display.begin(SSD1306_SWITCHCAPVCC, 0x3C)) { // Address 0x3C for 128x32
    Serial.println(F("SSD1306 allocation failed"));
    for(;;); // Don't proceed, loop forever
  }
  display.drawBitmap(0,0,logo_bmp,128,64,1);
  display.display();
  delay(1000);
  display.clearDisplay();

 splash();

  display.setTextSize(2); // Draw 2X-scale text(1=7px, 2=14px it means 2 times from the pixel)
  display.setTextColor(WHITE);  
  display.setCursor(5, 0);      //Draw the coordinate (x,y);
  display.println("REMOTE RC");
  
  pinMode(tombol,INPUT_PULLUP);
  pinMode(tombol2,INPUT_PULLUP);
  pinMode(pinMod,INPUT_PULLUP);
  pinMode(pinUp,INPUT_PULLUP);
  pinMode(pinDown,INPUT_PULLUP);
  pinMode(pinLeft,INPUT_PULLUP);
  pinMode(pinRight,INPUT_PULLUP);
  pinMode(pinKick,INPUT_PULLUP);
  
  rf24.begin();
  rf24.openWritingPipe(alamat);
  rf24.setPALevel(RF24_PA_LOW);
  rf24.stopListening();
  Serial.begin(9600);
}

void loop() {
  mod=digitalRead(pinMod);

  if(mod==0){
    tmr=0;
    while(mod==0){
       mod=digitalRead(pinMod);
       tmr=tmr+1;
       delay(1);
        if(tmr>2000){
          mod_F=1;
          setAddr();
        }
          
    }
    
  checkaddr();
  tmr=0;
  }

    
  int bacaTombol,bacaTombol2;
  bacaTombol=digitalRead(tombol);
  bacaTombol2=digitalRead(tombol2);
  if(bacaTombol==0) pesan[0]={1};
  else if(bacaTombol2==0) pesan[0]={2};
  else if(bacaTombol==1 && bacaTombol2==1)pesan[0]={0};
  if(bacaTombol==0 && bacaTombol2==0) {
    pesan[0]={3};
   }
  //else if(bacaTombol2==0) pesan[0]={2};
  //else if(bacaTombol2==1) pesan[0]={3};
  
  //pesan[0]=bacaTombol;
  Serial.print(bacaTombol);
  Serial.print("  ");
  Serial.print(bacaTombol2);
  Serial.print("  ");
  Serial.print(pesan[0]);
   Serial.print("  ");
   Serial.println(sizeof(alamat));
  rf24.write(pesan,4);



  checkbat_remot();
  display.display();  //Use this after use the script

  delay(10);
}

void splash(){
  display.setTextSize(2); // Draw 2X-scale text(1=7px, 2=14px it means 2 times from the pixel)
  display.setTextColor(WHITE);  
  display.setCursor(5, 0);      //Draw the coordinate (x,y);
  display.println("REMOTE RC");
  
  display.setTextSize(1); // Draw 2X-scale text(1=7px, 2=14px it means 2 times from the pixel)
  display.setCursor(50, 56);      //Draw the coordinate (x,y);
  display.println("by INOROBO");
  display.display();
  delay(2000);
  display.clearDisplay();

}

void mainscreen(){

  
}

void LOAD(){
  
}

void SAVE(){
  
}

void checkbat_remot(){
  display.clearDisplay();
  display.setCursor(5, 0);      //Draw the coordinate (x,y);
  display.println("REMOTE RC");
  
  
  batval=analogRead(pinbat);
  display.setTextSize(2);
  display.setCursor(0,16);
  display.print("RC Battry:");
  display.setCursor(40,32);
  display.print(90);
  display.setCursor(70,32);
  display.print(" %");
  display.setCursor(40,48);
  display.print(90);
  display.setCursor(70,48);
  display.print(" V");
}

void checkaddr(){
  display.clearDisplay();
  display.setCursor(5, 0);      //Draw the coordinate (x,y);
  display.println("REMOTE RC");
  
  
  display.setCursor(0,16);
  display.print("RC ADDRS :");
  display.setCursor(40,32);
  display.print(alamat);
  display.display();  //Use this after use the scrip
  delay(1000);
}

void setAddr(){

      while(mod_F==1){
         display.clearDisplay();
         display.setCursor(5, 0);      //Draw the coordinate (x,y);
         display.println("REMOTE RC");
          readpin();
          
          if(up_btn==0){
            select=select+1;
            delay(500);
          }
          if(dwn_btn==0){
            select=select-1;
            delay(500);
          }
          if(select>1) select=1;
          if(select<0) select=0;
          if(select==0){
            if(rgt_btn==0){
              mainch=mainch+1;
              delay(50);
            }
              if(lft_btn==0){
              mainch=mainch-1;
              delay(50);
            }
            if(mainch>255) {mainch=1;}
            else if(mainch<1) {mainch=255;}
          }
          if(select==1){
            if(rgt_btn==0){
              subch=subch+1;
              delay(50);
            }
              if(lft_btn==0){
              subch=subch-1;
              delay(50);
            }
            if(subch>255) {subch=1;}
            else if(subch<0) {subch=255;}
          }
        
          display.setCursor(0,16);
          display.print("-Set ADRS-");
          display.setCursor(0,32);
          display.print("MainCh:");
          display.print(mainch);
          display.setCursor(0,48);
          display.print("SubCh:");
          display.print(subch);
          display.display();

          Serial.print("  select= ");
          Serial.print(select);
                    Serial.print("  main= ");
          Serial.print(mainch);
                    Serial.print("  sub= ");
          Serial.println(subch);
          delay(10);
          
          
  }
}

void readpin(){
  mod_btn=digitalRead(pinMod);
  up_btn=digitalRead(pinUp);
  dwn_btn=digitalRead(pinDown);
  lft_btn=digitalRead(pinLeft);
  rgt_btn=digitalRead(pinRight);
  
}
