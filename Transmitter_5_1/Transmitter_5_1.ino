/*
   Project Name           : Remote Soccer
   Created by             : Ipko Salim
   Start Created          : 20.02.24
   Last Update            : 21.02.24
   Version                : 1.0
   Arduino IDE            : 1.8.10
   Hardware Requirment
    - Main Board          : Arduino pro mini 5V
    - Input               : Push button
    - Communication       : nRf24l01
    - Power               : Battery 3.7v 180560
                            Modul Charger TP4056
    - GUI                 : Oled 0.96" inci

   Update                 : - 'Move' Program
                            - OLED Display
                            - Battery Indicator
                            - Change Main and Sub channel
                            - !Save/Load Address from EEPROM
                            - !Kick Program
                            - !OTP number
                            - !Assembly Main,sub, and OTP   
   
   Library
    > nRF24L01.h 
    > Adafruit_SSD1306.h  V 2.4.0

*/
#include<SPI.h>
#include<EEPROM.h>

#include<nRF24L01.h>
#include<RF24.h>
#include <Wire.h>

#include <Adafruit_GFX.h>
#include <Adafruit_SSD1306.h>

#define SCREEN_WIDTH 128 // OLED display width, in pixels
#define SCREEN_HEIGHT 64 // OLED display height, in pixels

#define pinbat A7
#define pinLeft   8
#define pinRight  7
#define pinUp     3
#define pinDown   2
#define pinMod    5
#define pinKick   6
#define pinSpare  4

byte mod, up, dwn, lft, rgt, kick;
byte mod_btn, up_btn, dwn_btn, lft_btn, rgt_btn, kick_btn;
byte mod_F,otp_F;
byte select = 0;
byte mainch, subch,otpch;
float batval,batvalbuff1;
float batvalbuff2=0;
float batvalbuff3=0;
float batvalbuff4=0;
float batvalbuff5=0;
float batvalbuff6=0;
float batvalbuff7=0;
float batvalbuff8=0;
float batvalbuff9=0;
float batvalbuff10=0;
int batvalp;
int tmr;

int pesan[2] = {0, 1};
const int tombol = 2;
const int tombol2 = 3;
RF24 rf24(9, 10); //def 7,8

//byte alamat ="INO1099";
//byte ino="ino";
//int robo=123;
//byte alamat=ino+robo;
long int alamat = 1000;

#define OLED_RESET     4 // Reset pin # (or -1 if sharing Arduino reset pin)
Adafruit_SSD1306 display(SCREEN_WIDTH, SCREEN_HEIGHT, &Wire, OLED_RESET);

#define NUMFLAKES     10 // Number of snowflakes in the animation example

#define LOGO_HEIGHT   128
#define LOGO_WIDTH    64
static const unsigned char PROGMEM logo_bmp[] =
{
  0x00, 0x00, 0x00, 0x00, 0x00, 0x00, 0x00, 0x00,
  0x00, 0x00, 0x10, 0x0b, 0xd0, 0x08, 0x00, 0x00,
  0x00, 0x00, 0x10, 0x3f, 0xfc, 0x10, 0x00, 0x00,
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  0x00, 0x0b, 0xff, 0xf4, 0x2a, 0xaa, 0xa8, 0x00,
};
  

void setup() {
  display.setTextSize(1); // Draw 2X-scale text(1=7px, 2=14px it means 2 times from the pixel)
  display.setTextColor(WHITE);
  display.cp437(true);         // Use full 256 char 'Code Page 437' font
  display.clearDisplay();
  // SSD1306_SWITCHCAPVCC = generate display voltage from 3.3V internally
  if (!display.begin(SSD1306_SWITCHCAPVCC, 0x3C)) { // Address 0x3C for 128x32
    Serial.println(F("SSD1306 allocation failed"));
    for (;;); // Don't proceed, loop forever
  }
  display.drawBitmap(0, 0, logo_bmp, 128, 64, 1);
  display.display();
  delay(1000);
  display.clearDisplay();

  splash();

  display.setTextSize(2); // Draw 2X-scale text(1=7px, 2=14px it means 2 times from the pixel)
  display.setTextColor(WHITE);
  display.setCursor(5, 0);      //Draw the coordinate (x,y);
  display.println("REMOTE RC");

  pinMode(tombol, INPUT_PULLUP);
  pinMode(tombol2, INPUT_PULLUP);
  pinMode(pinMod, INPUT_PULLUP);
  pinMode(pinUp, INPUT_PULLUP);
  pinMode(pinDown, INPUT_PULLUP);
  pinMode(pinLeft, INPUT_PULLUP);
  pinMode(pinRight, INPUT_PULLUP);
  pinMode(pinKick, INPUT_PULLUP);

  LOAD();
  changeaddr();
  
  rf24.begin();
  rf24.openWritingPipe(alamat);
  rf24.setPALevel(RF24_PA_LOW);
  rf24.stopListening();
  Serial.begin(9600);
}

void loop() {
  //mod = digitalRead(pinMod);
  mainscreen();
}

void mainscreen() {
  checkbat_remot();
  readpin();
 if (mod_btn == 0) {
    tmr = 0;
    while (mod_btn == 0) {
      mod_btn = digitalRead(pinMod);
      tmr = tmr + 1;
      delay(1);
      if (tmr > 2000) {
        setAddr();
      }
    }

    checkaddr();
    tmr = 0;
  }

  if (up_btn == 0) {
    display.setCursor(0,50);
    display.setTextSize(1); // Draw 2X-scale text(1=7px, 2=14px it means 2 times from the pixel)
    display.print("F"); 
    pesan[0] = {1};
  }
  if (dwn_btn == 0) {
    display.setCursor(0,50);
    display.setTextSize(1);
    display.print("B"); 
    pesan[0] = {2};
  }
  if (lft_btn == 0) {
       display.setCursor(0,50);
       display.setTextSize(1);
    display.print("L"); 
    pesan[0] = {3};
  }
  if (rgt_btn == 0){
       display.setCursor(0,50);
       display.setTextSize(1);
    display.print("R"); 
    pesan[0] = {4};
  }
  if (kick_btn == 0) {
       display.setCursor(0,50);
       display.setTextSize(1);
    display.print("K"); 
    pesan[0] = {5};
  }
  //if (kick_btn == 1) pesan[0] = {55};
  
  if (up_btn == 0 && lft_btn == 0)pesan[0] = {6};
  if (up_btn == 0 && rgt_btn == 0)pesan[0] = {7};
  if (dwn_btn == 0 && lft_btn == 0)pesan[0] = {8};
  if (dwn_btn == 0 && rgt_btn == 0)pesan[0] = {9};

  if (up_btn == 1 && dwn_btn == 1 && lft_btn == 1 && rgt_btn == 1 && kick_btn == 1)pesan[0] = {0};
  
  Serial.print("  ");
  //Serial.print(bacaTombol2);
  Serial.print("  ");
  Serial.print(pesan[0]);
  Serial.print("  ");
  Serial.println(sizeof(alamat));
  rf24.write(pesan, 4);



  
  display.display();  //Use this after use the script

  delay(10);

}

void splash() {
  display.setTextSize(2); // Draw 2X-scale text(1=7px, 2=14px it means 2 times from the pixel)
  display.setTextColor(WHITE);
  display.setCursor(5, 0);      //Draw the coordinate (x,y);
  display.println("REMOTE RC");

  display.setTextSize(1); // Draw 2X-scale text(1=7px, 2=14px it means 2 times from the pixel)
  display.setCursor(50, 56);      //Draw the coordinate (x,y);
  display.println("by INOROBO");
  display.display();
  delay(2000);
  display.clearDisplay();
loading();
}



void LOAD() {
   
  mainch=EEPROM.read(0);
  subch=EEPROM.read(1);
  otpch=EEPROM.read(2);
  
}

void SAVE() {
  display.clearDisplay();
   display.setTextSize(2);
   display.setCursor(5, 0);      //Draw the coordinate (x,y);
   display.println("REMOTE RC");
   display.setCursor(10, 24);
   display.print("Saving...");
   display.display();
  
  EEPROM.write(0, mainch);
  EEPROM.write(1, subch);
  EEPROM.write(2,otpch);
   delay(700);
}

void checkbat_remot() {
  display.clearDisplay();
  


  float batvall = analogRead(pinbat);
  batvalbuff1=batvall;
  batvalbuff2=(batvalbuff2+batvalbuff1)/2;
  batvalbuff3=(batvalbuff3+batvalbuff2)/2;
  batvalbuff4=(batvalbuff4+batvalbuff3)/2;
  batvalbuff5=(batvalbuff5+batvalbuff4)/2;
  batvalbuff6=(batvalbuff6+batvalbuff5)/2;
  batvalbuff7=(batvalbuff7+batvalbuff6)/2;
  batvalbuff8=(batvalbuff8+batvalbuff7)/2;
  batvalbuff9=(batvalbuff9+batvalbuff8)/2;
  batvalbuff10=(batvalbuff10+batvalbuff9)/2;
  
 
  batval=(batvalbuff10*4.2)/860;
  batvalp=map(batvalbuff10,750,860,0,100);

  display.setTextSize(2);
  display.setCursor(5, 0);      //Draw the coordinate (x,y);
  display.println("REMOTE RC");
  display.setCursor(0, 16);
  display.print("RC Battry:");
  display.setCursor(50, 32);
  display.print(batvalp);
  display.setCursor(70, 32);
  display.print(" %");
  display.setCursor(40, 48);
  display.print(batval);
  display.setCursor(80, 48);
  display.print(" V");
  
}

void checkaddr() {
  LOAD();
  String mainch_s=String(mainch);
  String subch_s=String(subch);
  String otpch_s=String(otpch);
  String pair=mainch_s+subch_s+otpch_s;
  display.clearDisplay();
  display.setCursor(5, 0);      //Draw the coordinate (x,y);
  display.println("REMOTE RC");


  display.setCursor(0, 16);
  display.print("RC ADDRS :");
  display.setCursor(0, 32);
  display.print(pair);
  display.setCursor(0, 48);
  display.print(alamat);
  display.display();  //Use this after use the scrip
  delay(1000);
}

void setAddr() {
  select=1;
  mod_F = 1;
  loading();
  display.clearDisplay();
  display.setCursor(5, 0);      //Draw the coordinate (x,y);
  display.println("REMOTE RC");
  display.setCursor(0, 16);
  display.print("-Set ADRS-");
  display.display();
  delay(1000);
    LOAD();
  while (mod_F == 1) {
    display.clearDisplay();
    readpin();

    if (up_btn == 0) {
      select = 1;
    }
    if (dwn_btn == 0) {
      select = 2;
    }

    if (select == 1) {
    display.fillCircle(115,37,3,WHITE);
      if (rgt_btn == 0) {
        mainch = mainch + 1;
        delay(10);
      }
      if (lft_btn == 0) {
        mainch = mainch - 1;
        delay(10);
      }
      if (mainch > 255) {
        mainch = 1;
      }
      else if (mainch < 1) {
        mainch = 255;
      }
    }
    if (select == 2) {
    display.fillCircle(115,55,3,WHITE);
  
    if (rgt_btn == 0) {
        subch = subch + 1;
        delay(10);
      }
      if (lft_btn == 0) {
        subch = subch - 1;
        delay(10);
      }
      if (subch > 255) {
        subch = 1;
      }
      else if (subch < 0) {
        subch = 255;
      }
    }


  if (mod_btn == 0) {
    tmr = 0;
    while (mod_btn == 0) {
      readpin();
      tmr = tmr + 1;
      delay(1);
      if (tmr > 2000) {
        otp_F=1;
        OTP();
      }
    }
    tmr = 0;
  }

    display.setCursor(5, 0);      //Draw the coordinate (x,y);
    display.println("REMOTE RC");
    display.setCursor(0, 16);
    display.print("-Set ADRS-");    
    display.setCursor(0, 32);
    display.print("MnCh:");
    display.print(mainch);
    display.setCursor(0, 48);
    display.print("SbCh:");
    display.print(subch);
    display.display();

    Serial.print("  select= ");
    Serial.print(select);
    Serial.print("  main= ");
    Serial.print(mainch);
    Serial.print("  sub= ");
    Serial.println(subch);
    delay(10);

  }
}

void OTP(){
  loading();
  display.clearDisplay();
  display.setCursor(5, 0);      //Draw the coordinate (x,y);
  display.println("REMOTE RC");
  display.setCursor(0, 16);
  display.print("-Set OTP-");
  display.display();
  delay(1000);

while (otp_F==1){
display.clearDisplay();
readpin();
    if (rgt_btn == 0) {
        otpch = otpch + 1;
        delay(10);
      }
      if (lft_btn == 0) {
        otpch = otpch - 1;
        delay(10);
      }

    display.setCursor(5, 0);      //Draw the coordinate (x,y);
    display.println("REMOTE RC");
    display.setCursor(0, 16);
    display.print("-Set OTP-");

    
    display.setCursor(0, 32);
    display.print("OTP CODE:");   
    display.setCursor(50, 48);
    display.print(otpch);
    display.display();

     delay(10);

    if (mod_btn == 0) {
      SAVE();
      delay(100);
 
      LOAD();
      changeaddr();

      mod_F = 0;
      otp_F=0;
      mainscreen();
    }
  
}


}

void loading(){
  display.clearDisplay();
  display.setTextSize(2);
   display.setCursor(5, 0);      //Draw the coordinate (x,y);
   display.println("REMOTE RC");
   display.setCursor(10, 24);
   display.print("loading..");
   display.display();
   delay(700);
}

void readpin() {
  mod_btn = digitalRead(pinMod);
  up_btn = digitalRead(pinUp);
  dwn_btn = digitalRead(pinDown);
  lft_btn = digitalRead(pinLeft);
  rgt_btn = digitalRead(pinRight);
  kick_btn=digitalRead(pinKick);
}

void changeaddr(){
String mainch_s=String(mainch);
  String subch_s=String(subch);
  String otpch_s=String(otpch);
  String pair=mainch_s+subch_s+otpch_s;
alamat=pair.toInt();

  
//  long mainch_L=mainch*1000000;
//  long subch_L=subch*1000;
//  int otpch_L=otpch;
//  alamat=mainch_L+subch_L+otpch_L;
//  rf24.begin();
//  rf24.openWritingPipe(alamat);
//  rf24.setPALevel(RF24_PA_LOW);
//  rf24.stopListening();
  
  delay(250);
}
